/*Bgein added by hailong.chen for XR5598906 on 2017/11/24  added byd battery parameter*/
A3A_battery_byd{
	battery_profile_t0_num = <60>;
	maxid = <871>;
	minid = <671>;
	battery_name = "BYD";
	Q_max = <2904>;
	battery_id = <0>;
	battery_profile_t0 =
	<
	0	43366	605 
	200	43156	605 
	700	42947	605 
	1200	42742	610 
	1699	42538	615 
	2199	42337	620 
	2699	42140	633 
	3199	41944	642 
	3698	41751	650 
	4198	41560	665 
	4698	41372	677 
	5198	41186	690 
	5697	41005	708 
	6197	40827	725 
	6697	40655	748 
	7197	40487	775 
	7697	40323	795 
	8196	40164	823 
	8696	40011	852 
	9195	39867	892 
	9695	39726	932 
	10195	39589	975 
	10695	39453	1023 
	11195	39301	1035 
	11695	39107	955 
	12195	38900	840 
	12695	38744	825 
	13194	38622	850 
	13694	38517	872 
	14193	38424	895 
	14693	38338	913 
	15193	38259	933 
	15692	38186	952 
	16192	38118	975 
	16691	38053	990 
	17191	37995	1015 
	17691	37942	1040 
	18191	37892	1068 
	18691	37846	1093 
	19190	37802	1120 
	19689	37749	1120 
	20189	37657	1035 
	20689	37541	915 
	21189	37472	965 
	21689	37404	983 
	22189	37334	980 
	22689	37277	1003 
	23189	37220	1015 
	23689	37134	963 
	24189	37029	910 
	24689	36930	910 
	25188	36801	857 
	25688	36776	1055 
	26188	36759	1110 
	26687	36726	1128 
	27187	36514	783 
	27687	35781	783 
	28187	34576	783 
	28187	34576	783 
	28187	34576	783 
    >;
    /*Begin modified by hailong.chen for XR5598906 fix some parameter on 2017/11/24*/
    /*T0:
    	27687 36514 -545  >>>>> 27687 36514 783	(98%)
    	28187 34576 -1700 >>>>> 28187 34576 783	(100%)
 	*/
    /*End modified by hailong.chen for XR5598906 fix some parameter on 2017/11/24*/

	battery_profile_t1_num = <60>;
	battery_profile_t1 =
	<
	0	43659	1138 
	200	43449	1138 
	700	43238	1100 
	1200	43024	1090 
	1700	42814	1080 
	2200	42610	1085 
	2700	42407	1100 
	3200	42207	1100 
	3700	42011	1118 
	4200	41817	1138 
	4700	41627	1152 
	5200	41440	1175 
	5700	41253	1195 
	6200	41070	1215 
	6700	40891	1248 
	7200	40739	1343 
	7700	40634	1500 
	8200	40399	1265 
	8700	40135	1167 
	9200	39958	1385 
	9700	39857	1622 
	10200	39752	1678 
	10700	39617	1655 
	11200	39464	1615 
	11700	39290	1550 
	12200	39098	1430 
	12700	38922	1343 
	13201	38775	1303 
	13701	38653	1293 
	14200	38547	1300 
	14700	38451	1315 
	15200	38367	1325 
	15700	38289	1345 
	16199	38217	1375 
	16699	38151	1393 
	17199	38089	1415 
	17699	38032	1438 
	18198	37980	1470 
	18698	37932	1488 
	19197	37888	1518 
	19697	37844	1540 
	20197	37799	1543 
	20697	37753	1543 
	21197	37704	1525 
	21697	37652	1493 
	22197	37591	1445 
	22697	37525	1413 
	23197	37469	1423 
	23697	37411	1423 
	24197	37323	1370 
	24697	37221	1338 
	25198	37126	1355 
	25698	36987	1275 
	26198	36936	1470 
	26698	36918	1573 
	27198	36892	1620 
	27698	36795	1548 
	28198	36201	1548 
	28698	35135	1548 
	29198	34000	1548 
	>;
	 /*Begin modified by hailong.chen for XR5598906 fix some parameter on 2017/11/24*/
    /*T1:
    	28198 36201  463  >>>>> 28198 36201 1548	(97%)
    	28698 35135 -720  >>>>> 28698 35135 1548	(99%)
    	29198 33456 -1963 >>>>> 29198 34000 1548	(101%)
 	*/
    /*End modified by hailong.chen for XR5598906 fix some parameter on 2017/11/24*/
    
	battery_profile_t2_num = <60>;
	battery_profile_t2 =
	<
	0	43518	4845 
	200	43271	4845 
	700	43036	4878 
	1201	42819	4752 
	1701	42610	4692 
	2201	42406	4640 
	2700	42205	4585 
	3200	42010	4552 
	3700	41823	4535 
	4200	41639	4487 
	4700	41455	4475 
	5200	41268	4463 
	5700	41086	4455 
	6200	40925	4480 
	6700	40807	4560 
	7200	40637	4570 
	7700	40320	4318 
	8200	40000	4105 
	8700	39769	4105 
	9201	39598	4135 
	9701	39480	4185 
	10202	39372	4195 
	10703	39243	4143 
	11204	39106	4082 
	11704	38972	4038 
	12204	38848	4023 
	12704	38731	4013 
	13204	38622	4020 
	13704	38523	4040 
	14204	38432	4055 
	14704	38346	4090 
	15204	38267	4132 
	15704	38193	4173 
	16204	38125	4213 
	16704	38061	4255 
	17204	38004	4300 
	17704	37949	4340 
	18204	37898	4385 
	18704	37855	4433 
	19204	37821	4485 
	19705	37793	4540 
	20205	37766	4595 
	20705	37735	4653 
	21205	37701	4715 
	21705	37660	4800 
	22205	37611	4888 
	22705	37552	4997 
	23205	37481	5132 
	23705	37402	5295 
	24205	37309	5508 
	24705	37199	5773 
	25205	37098	6158 
	25705	37031	6760 
	26205	36978	7555 
	26706	36908	8650 
	27206	36737	10210 
	27707	36209	12123 
	28208	35203	13060 
	28709	34000	13060 
	28709	34000	13060 
	>;
	/*Begin modified by hailong.chen for XR5598906 fix some parameter on 2017/11/24*/
    /*T2:
    	28709 33331  12493  >>>>> 28709 34000 13060	(101%)
 	*/
    /*End modified by hailong.chen for XR5598906 fix some parameter on 2017/11/24*/
    
	battery_profile_t3_num = <60>;
	battery_profile_t3 =
	<
	0	43310	10225 
	200	43030	10225 
	700	42784	10518 
	1200	42551	10448 
	1700	42327	10280 
	2200	42114	10098 
	2700	41912	9892 
	3200	41715	9720 
	3700	41516	9528 
	4200	41321	9368 
	4700	41125	9203 
	5200	40968	9125 
	5700	40823	9075 
	6200	40623	8923 
	6699	40315	8573 
	7200	40003	8250 
	7700	39767	8150 
	8200	39591	8128 
	8699	39458	8168 
	9199	39356	8220 
	9699	39238	8208 
	10199	39110	8153 
	10699	38981	8093 
	11200	38860	8053 
	11700	38744	8055 
	12200	38635	8058 
	12700	38534	8065 
	13200	38440	8080 
	13700	38352	8090 
	14200	38270	8125 
	14700	38195	8133 
	15200	38126	8190 
	15700	38058	8233 
	16200	38001	8282 
	16700	37952	8365 
	17200	37914	8460 
	17700	37881	8548 
	18200	37852	8635 
	18699	37824	8748 
	19199	37795	8868 
	19699	37763	9008 
	20199	37729	9210 
	20699	37688	9428 
	21199	37642	9663 
	21699	37590	9975 
	22199	37530	10343 
	22699	37465	10793 
	23199	37386	11320 
	23699	37299	11970 
	24199	37207	12748 
	24699	37122	13618 
	25199	37049	14528 
	25699	36978	15385 
	26199	36887	16153 
	26699	36729	16833 
	27199	36369	17310 
	27699	35673	17600 
	28699	34204	13928 
	29119	34000	12785 
	29119	34000	12785 
	>;
	/*Begin modified by hailong.chen for XR5598906 fix some parameter on 2017/11/24*/
    /*T3:
    	29119 33747 12785  >>>>> 29119 34000 12785	(101%)
 	*/
    /*End modified by hailong.chen for XR5598906 fix some parameter on 2017/11/24*/
};
/*End added by hailong.chen for XR5598906 on 2017/11/24  added byd battery parameter*/
