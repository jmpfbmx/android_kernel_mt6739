/*Bgein added by hailong.chen for XR5598906 on 2017/11/24  adding veken battery parameter*/
A3A_battery_veken{
	battery_profile_t0_num = <60>;
	maxid = <1397>;
	minid = <1197>;
	battery_name = "VEKEN";
	Q_max = <2900>;
	battery_id = <1>;
	battery_profile_t0 =
	<
	0	43892	2138 
	500	43687	2138 
	1000	43501	2123 
	1500	43328	2140 
	2000	43142	2140 
	2500	42950	2140 
	3000	42751	2138 
	3500	42553	2140 
	4000	42354	2153 
	4500	42156	2140 
	5000	41970	2170 
	5500	41772	2170 
	6000	41579	2170 
	6500	41393	2185 
	7000	41207	2200 
	7500	41021	2215 
	8000	40842	2233 
	8500	40662	2248 
	9000	40494	2248 
	9500	40327	2295 
	10000	40159	2293 
	10500	39973	2325 
	11000	39843	2370 
	11500	39701	2403 
	12000	39552	2435 
	12500	39372	2403 
	13000	39149	2232 
	13500	38950	2138 
	14000	38808	2125 
	14500	38690	2108 
	15000	38578	2123 
	15500	38473	2108 
	16000	38386	2138 
	16500	38299	2137 
	17000	38213	2140 
	17500	38132	2170 
	18000	38064	2218 
	18500	37996	2232 
	19000	37934	2265 
	19500	37872	2280 
	20000	37810	2295 
	20500	37760	2340 
	21000	37661	2280 
	21500	37524	2155 
	22000	37431	2170 
	22500	37357	2218 
	23000	37270	2185 
	23500	37202	2203 
	24000	37134	2203 
	24500	37059	2215 
	25000	36960	2200 
	25500	36861	2233 
	26000	36731	2155 
	26500	36687	2170 
	27000	36662	2215 
	27500	36631	2293 
	28000	36520	2403 
	28500	35925	2295 
	29000	34945	2450 
	29500	34000	2450 
    >;
	/*Begin modified by hailong.chen for XR5598906 fix some parameter on 2017/11/24*/
    /*T0:
    	29500 33097 12785  >>>>> 29500 34000 2450	(101%)
 	*/
    /*End modified by hailong.chen for XR5598906 fix some parameter on 2017/11/24*/
    
	battery_profile_t1_num = <60>;
	battery_profile_t1 =
	<
	0	43836	2077 
	500	43644	2077 
	1000	43477	2048 
	1500	43278	2030 
	2000	43080	2030 
	2500	42875	2030 
	3000	42683	2015 
	3500	42485	2015 
	4000	42292	2045 
	4500	42094	2063 
	5000	41908	2122 
	5500	41722	2155 
	6000	41536	2200 
	6500	41344	2233 
	7000	41164	2280 
	7500	40972	2280 
	8000	40804	2355 
	8500	40674	2450 
	9000	40556	2543 
	9500	40277	2418 
	10000	40004	2418 
	10500	39818	2447 
	11000	39694	2495 
	11500	39608	2542 
	12000	39440	2388 
	12500	39242	2185 
	13000	39056	2015 
	13500	38913	1953 
	14000	38795	1920 
	14500	38684	1922 
	15000	38585	1923 
	15500	38498	1938 
	16000	38411	1953 
	16500	38324	1968 
	17000	38250	1970 
	17500	38182	1985 
	18000	38113	1983 
	18500	38058	1970 
	19000	37996	1970 
	19500	37934	1970 
	20000	37878	1955 
	20500	37816	1923 
	21000	37735	1875 
	21500	37648	1813 
	22000	37568	1800 
	22500	37487	1782 
	23000	37431	1813 
	23500	37382	1878 
	24000	37307	1905 
	24500	37214	1923 
	25000	37121	1968 
	25500	36991	1953 
	26000	36923	1970 
	26500	36898	2045 
	27000	36873	2185 
	27500	36817	2340 
	28000	36402	2295 
	28500	35528	2435 
	29000	33996	2853 
	29000	33996	2853 
	>;
    
	battery_profile_t2_num = <60>;
	battery_profile_t2 =
	<
	0	43849	10728 
	500	43576	10728 
	1000	43315	10725 
	1500	43080	10603 
	2000	42857	10448 
	2500	42633	10293 
	3000	42447	10230 
	3500	42249	10075 
	4000	42063	10013 
	4500	41865	9923 
	5000	41666	9795 
	5500	41493	9735 
	6000	41294	9610 
	6500	41133	9580 
	7000	40984	9517 
	7500	40835	9548 
	8000	40600	9332 
	8500	40290	9023 
	9000	40004	8742 
	9500	39781	8588 
	10000	39595	8433 
	10500	39459	8433 
	11000	39322	8307 
	11500	39211	8247 
	12000	39087	8155 
	12500	38975	8060 
	13000	38864	7968 
	13500	38752	7905 
	14000	38653	7875 
	14500	38566	7875 
	15000	38492	7875 
	15500	38392	7813 
	16000	38343	7905 
	16500	38256	7813 
	17000	38194	7875 
	17500	38120	7875 
	18000	38070	7905 
	18500	38033	8030 
	19000	37996	8155 
	19500	37958	8245 
	20000	37921	8340 
	20500	37884	8463 
	21000	37847	8588 
	21500	37785	8683 
	22000	37735	8835 
	22500	37673	8960 
	23000	37611	9145 
	23500	37524	9363 
	24000	37413	9580 
	24500	37313	9828 
	25000	37202	10138 
	25500	37115	10478 
	26000	37078	10975 
	26500	37028	11655 
	27000	36904	12493 
	27500	36321	12990 
	28000	35280	13890 
	28500	34000	13890 
	28500	34000	13890 
	28500	34000	13890 
	>;
	/*Begin modified by hailong.chen for XR5598906 fix some parameter on 2017/11/24*/
    /*T2:
    	28500 33172 15905  >>>>> 28500 34000 13890	(101%)
 	*/
    /*End modified by hailong.chen for XR5598906 fix some parameter on 2017/11/24*/
	battery_profile_t3_num = <60>;
	battery_profile_t3 =
	<
	0	43849	17733 
	500	43514	17733 
	1000	43204	17363 
	1500	42931	16895 
	2000	42683	16400 
	2500	42460	15935 
	3000	42261	15563 
	3500	42063	15223 
	4000	41865	14883 
	4500	41666	14603 
	5000	41493	14355 
	5500	41307	14108 
	6000	41145	13920 
	6500	40959	13765 
	7000	40761	13548 
	7500	40488	13145 
	8000	40203	12835 
	8500	39955	12555 
	9000	39756	12430 
	9500	39583	12308 
	10000	39434	12278 
	10500	39322	12275 
	11000	39211	12248 
	11500	39087	12185 
	12000	38975	12090 
	12500	38876	12060 
	13000	38764	11998 
	13500	38678	12000 
	14000	38578	11965 
	14500	38504	11968 
	15000	38405	11905 
	15500	38330	11965 
	16000	38268	11998 
	16500	38219	12060 
	17000	38169	12153 
	17500	38107	12245 
	18000	38058	12340 
	18500	38020	12430 
	19000	37983	12555 
	19500	37946	12743 
	20000	37896	12835 
	20500	37859	12990 
	21000	37810	13145 
	21500	37760	13270 
	22000	37710	13423 
	22500	37648	13610 
	23000	37586	13795 
	23500	37512	14013 
	24000	37413	14168 
	24500	37326	14448 
	25000	37251	14725 
	25500	37189	15128 
	26000	37115	15563 
	26500	37041	16123 
	27000	36879	16770 
	27500	36421	17270 
	28000	35515	17825 
	28500	33792	19315 
	28500	33792	19315 
	28500	33792	19315 
	>;
};
/*End added by hailong.chen for XR5598906 on 2017/11/24  adding veken battery parameter*/
