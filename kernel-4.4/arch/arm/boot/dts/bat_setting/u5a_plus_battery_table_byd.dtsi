/*Bgein added by shiqiang.chen.hz on 2017/12/20  added byd battery parameter */
u5a_plus_battery_byd{
	battery_profile_t0_num = <100>;
	maxid = <1212>;
	minid = <1012>;
	battery_name = "BYD";
	Q_max = <2430>;
	battery_id = <0>;	//add battery name&id by shiqiang.chen.hz ,.
	battery_profile_t0 =
	<
	0	43790	0
	250	43640	10
	501	43500	21
	751	43374	31
	1001	43239	41
	1252	43127	52
	1502	43004	62
	1752	42874	72
	2003	42749	83
	2253	42636	93
	2503	42513	103
	2754	42383	114
	3004	42258	124
	3254	42146	135
	3505	42028	145
	3755	41910	155
	4005	41777	166
	4256	41665	176
	4506	41547	186
	4756	41429	197
	5007	41316	207
	5257	41194	217
	5507	41082	228
	5758	40985	238
	6008	40877	248
	6258	40774	259
	6509	40656	269
	6759	40554	279
	7009	40456	290
	7260	40349	300
	7510	40256	310
	7760	40156	321
	8011	40056	331
	8261	39959	342
	8512	39877	352
	8762	39785	362
	9012	39696	373
	9263	39621	383
	9513	39540	393
	9763	39445	404
	10014	39356	414
	10264	39271	424
	10514	39153	435
	10765	39019	445
	11015	38884	455
	11265	38784	466
	11516	38701	476
	11766	38630	486
	12016	38566	497
	12267	38507	507
	12517	38451	517
	12767	38397	528
	13018	38346	538
	13268	38286	548
	13518	38242	559
	13769	38196	569
	14019	38156	580
	14269	38106	590
	14520	38062	600
	14770	38024	611
	15020	37997	621
	15271	37963	631
	15521	37932	642
	15771	37903	652
	16022	37868	662
	16272	37843	673
	16522	37818	683
	16773	37784	693
	17023	37745	704
	17273	37695	714
	17524	37626	724
	17774	37548	735
	18024	37496	745
	18275	37459	755
	18525	37421	766
	18775	37375	776
	19026	37336	787
	19276	37298	797
	19526	37267	807
	19777	37233	818
	20027	37183	828
	20277	37120	838
	20528	37058	849
	20778	36995	859
	21028	36941	869
	21279	36858	880
	21529	36784	890
	21779	36761	900
	22030	36748	911
	22280	36740	921
	22530	36740	931
	22781	36713	942
	23031	36637	952
	23281	36396	962
	23532	35967	973
	23782	35400	983
	24032	34652	993
	24283	33440	1004
	24533	32710	1009
	24783	32710	1009
	>;
	battery_profile_t1_num = <100>;
	battery_profile_t1 =
	<
	0	43820	1150
	250	43667	1144
	501	43520	1138
	751	43387	1150
	1001	43269	1150
	1252	43142	1169
	1502	43009	1150
	1752	42884	1188
	2003	42759	1175
	2253	42636	1157
	2503	42523	1201
	2754	42395	1187
	3004	42268	1199
	3254	42146	1164
	3505	42033	1200
	3755	41920	1219
	4005	41798	1201
	4256	41685	1232
	4506	41567	1223
	4756	41457	1220
	5007	41347	1225
	5257	41224	1232
	5507	41112	1250
	5758	40999	1250
	6008	40897	1251
	6258	40797	1282
	6509	40702	1286
	6759	40646	1374
	7009	40564	1421
	7260	40408	1343
	7510	40244	1353
	7760	40086	1295
	8011	39967	1328
	8261	39895	1375
	8512	39838	1389
	8762	39788	1420
	9012	39726	1448
	9263	39641	1425
	9513	39555	1397
	9763	39463	1436
	10014	39374	1422
	10264	39264	1375
	10514	39153	1318
	10765	39036	1275
	11015	38914	1173
	11265	38811	1126
	11516	38715	1075
	11766	38640	1075
	12016	38586	1121
	12267	38520	1075
	12517	38462	1075
	12767	38417	1096
	13018	38357	1075
	13268	38316	1075
	13518	38266	1075
	13769	38216	1075
	14019	38167	1055
	14269	38130	1091
	14520	38092	1075
	14770	38055	1075
	15020	38028	1103
	15271	37999	1125
	15521	37968	1140
	15771	37934	1150
	16022	37899	1103
	16272	37883	1134
	16522	37852	1150
	16773	37831	1150
	17023	37807	1150
	17273	37769	1141
	17524	37725	1094
	17774	37684	1053
	18024	37658	1075
	18275	37629	1066
	18525	37597	1050
	18775	37564	1072
	19026	37517	1053
	19276	37489	1075
	19526	37451	1075
	19777	37413	1075
	20027	37376	1100
	20277	37327	1090
	20528	37264	1107
	20778	37205	1103
	21028	37143	1104
	21279	37076	1125
	21529	36982	1093
	21779	36923	1097
	22030	36899	1104
	22280	36890	1135
	22530	36883	1183
	22781	36862	1200
	23031	36852	1304
	23281	36769	1325
	23532	36519	1292
	23782	36074	1343
	24032	35463	1449
	24283	34612	1658
	24533	33255	2191
	24783	30270	22350
	>;
	battery_profile_t2_num = <100>;
	battery_profile_t2 =
	<
	0	43730	5275
	250	43570	5288
	501	43420	5300
	751	43292	5332
	1001	43149	5275
	1252	43029	5256
	1502	42894	5200
	1752	42774	5200
	2003	42659	5200
	2253	42543	5180
	2503	42413	5099
	2754	42283	5037
	3004	42168	5026
	3254	42056	5043
	3505	41943	5012
	3755	41822	4981
	4005	41708	4926
	4256	41605	4943
	4506	41498	4938
	4756	41397	4970
	5007	41277	4900
	5257	41164	4893
	5507	41052	4875
	5758	40955	4875
	6008	40878	4904
	6258	40812	5029
	6509	40737	5127
	6759	40622	5090
	7009	40453	4943
	7260	40265	4785
	7510	40072	4681
	7760	39920	4625
	8011	39786	4578
	8261	39696	4610
	8512	39607	4589
	8762	39540	4620
	9012	39476	4650
	9263	39401	4642
	9513	39321	4597
	9763	39225	4514
	10014	39145	4497
	10264	39048	4442
	10514	38966	4439
	10765	38874	4409
	11015	38795	4398
	11265	38710	4375
	11516	38641	4389
	11766	38579	4400
	12016	38508	4381
	12267	38460	4433
	12517	38402	4429
	12767	38348	4450
	13018	38287	4454
	13268	38250	4508
	13518	38206	4525
	13769	38156	4546
	14019	38117	4530
	14269	38080	4584
	14520	38042	4600
	14770	38013	4642
	15020	37978	4633
	15271	37949	4691
	15521	37918	4705
	15771	37893	4746
	16022	37867	4775
	16272	37840	4802
	16522	37828	4835
	16773	37811	4847
	17023	37799	4875
	17273	37786	4893
	17524	37780	4971
	17774	37754	5000
	18024	37736	5056
	18275	37703	5119
	18525	37684	5213
	18775	37654	5316
	19026	37616	5410
	19276	37579	5542
	19526	37541	5745
	19777	37503	5933
	20027	37462	6139
	20277	37395	6293
	20528	37338	6544
	20778	37267	6759
	21028	37211	7053
	21279	37132	7304
	21529	37051	7603
	21779	36985	7969
	22030	36959	8413
	22280	36938	8935
	22530	36907	9517
	22781	36864	10220
	23031	36819	11099
	23281	36703	12091
	23532	36435	13028
	23782	35976	13867
	24032	35333	14756
	24283	34378	15414
	24533	32672	15176
	24783	30020	26325
	>;
	battery_profile_t3_num = <100>;
	battery_profile_t3 =
	<
	0	43770	11600
	250	43577	11625
	501	43420	11700
	751	43269	11681
	1001	43119	11600
	1252	42989	11518
	1502	42854	11412
	1752	42726	11343
	2003	42599	11224
	2253	42483	11123
	2503	42358	10998
	2754	42225	10854
	3004	42108	10773
	3254	41996	10686
	3505	41883	10611
	3755	41770	10517
	4005	41658	10423
	4256	41548	10336
	4506	41442	10273
	4756	41330	10211
	5007	41197	10075
	5257	41094	10061
	5507	40987	9985
	5758	40903	9970
	6008	40818	9978
	6258	40741	10035
	6509	40621	9973
	6759	40485	9890
	7009	40303	9693
	7260	40109	9505
	7510	39918	9359
	7760	39772	9285
	8011	39655	9299
	8261	39542	9260
	8512	39447	9239
	8762	39371	9250
	9012	39317	9277
	9263	39251	9300
	9513	39176	9286
	9763	39101	9275
	10014	39026	9250
	10264	38948	9234
	10514	38866	9186
	10765	38791	9154
	11015	38716	9150
	11265	38657	9150
	11516	38595	9164
	11766	38529	9175
	12016	38475	9202
	12267	38410	9233
	12517	38361	9265
	12767	38298	9254
	13018	38247	9277
	13268	38203	9300
	13518	38152	9315
	13769	38115	9367
	14019	38077	9405
	14269	38040	9459
	14520	38002	9490
	14770	37965	9542
	15020	37929	9583
	15271	37913	9668
	15521	37882	9700
	15771	37870	9786
	16022	37849	9795
	16272	37840	9406
	16522	37828	9135
	16773	37811	9513
	17023	37798	10076
	17273	37780	10358
	17524	37761	10562
	17774	37741	10731
	18024	37708	10921
	18275	37686	11178
	18525	37661	11475
	18775	37624	11792
	19026	37586	12092
	19276	37549	12490
	19526	37511	12929
	19777	37473	13385
	20027	37423	13823
	20277	37368	14291
	20528	37318	14775
	20778	37255	15235
	21028	37193	15697
	21279	37130	16114
	21529	37074	16552
	21779	37024	16945
	22030	36985	17296
	22280	36952	17671
	22530	36920	18014
	22781	36865	18304
	23031	36797	18636
	23281	36664	18918
	23532	36398	19183
	23782	35990	19502
	24032	35377	19908
	24283	34488	20170
	24533	32990	21420
	24783	30090	26225
	>;
};
/*End added by shiqiang.chen.hz on 2017/12/20  added byd battery parameter */
