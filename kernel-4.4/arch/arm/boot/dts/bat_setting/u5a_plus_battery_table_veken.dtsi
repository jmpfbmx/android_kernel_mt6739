/*Bgein added by shiqiang.chen.hz on 2017/12/20  added weike battery parameter */
u5a_plus_battery_veken{
	battery_profile_t0_num = <100>;
	maxid = <498>;
	minid = <298>;
	battery_name = "VEKEN";
	Q_max = <2430>;
	battery_id = <1>;	//add battery name&id by shiqiang.chen.hz ,.
	battery_profile_t0 =
	<
	0	43805	2030
	249	43659	2030
	498	43530	2030
	747	43408	2018
	996	43295	2015
	1245	43180	2015
	1494	43063	2025
	1743	42947	2030
	1992	42830	2030
	2240	42714	2030
	2489	42595	2031
	2738	42475	2032
	2987	42358	2037
	3236	42240	2047
	3485	42118	2045
	3734	42002	2045
	3983	41885	2045
	4232	41763	2045
	4481	41652	2059
	4730	41536	2047
	4979	41419	2057
	5228	41308	2073
	5477	41197	2078
	5726	41086	2078
	5975	40976	2086
	6223	40868	2101
	6472	40763	2109
	6721	40656	2107
	6970	40549	2113
	7219	40450	2128
	7468	40351	2138
	7717	40252	2144
	7966	40153	2170
	8215	40054	2170
	8464	39961	2170
	8713	39879	2196
	8962	39782	2214
	9211	39697	2240
	9460	39615	2268
	9709	39534	2287
	9958	39452	2320
	10207	39367	2355
	10455	39272	2356
	10704	39145	2291
	10953	38985	2169
	11202	38841	2069
	11451	38747	2046
	11700	38673	2047
	11949	38602	2044
	12198	38533	2030
	12447	38469	2030
	12696	38416	2044
	12945	38358	2032
	13194	38305	2042
	13443	38257	2047
	13692	38207	2047
	13941	38154	2048
	14190	38109	2056
	14438	38068	2070
	14687	38027	2084
	14936	37989	2099
	15185	37952	2105
	15434	37912	2096
	15683	37878	2111
	15932	37849	2127
	16181	37814	2141
	16430	37785	2155
	16679	37756	2186
	16928	37721	2174
	17177	37686	2170
	17426	37637	2147
	17675	37563	2086
	17924	37489	2061
	18173	37430	2060
	18422	37384	2069
	18670	37340	2076
	18919	37294	2076
	19168	37247	2072
	19417	37204	2065
	19666	37169	2081
	19915	37133	2090
	20164	37092	2077
	20413	37045	2093
	20662	36982	2095
	20911	36934	2050
	21160	36876	2085
	21409	36809	2093
	21658	36725	2071
	21907	36679	2063
	22156	36661	2072
	22405	36653	2102
	22653	36641	2130
	22902	36623	2171
	23151	36584	2234
	23400	36440	2234
	23649	36105	2189
	23898	35593	2259
	24147	34894	2335
	24396	33866	2594
	24645	32043	3860
	>;
	battery_profile_t1_num = <100>;
	battery_profile_t1 =
	<
	0	43824	2155
	249	43685	2155
	498	43572	2168
	747	43457	2170
	996	43336	2148
	1245	43219	2128
	1494	43103	2133
	1743	42980	2123
	1992	42859	2101
	2240	42743	2100
	2489	42624	2104
	2738	42503	2093
	2987	42387	2096
	3236	42270	2105
	3485	42149	2093
	3734	42034	2094
	3983	41923	2122
	4232	41802	2095
	4481	41690	2105
	4730	41581	2109
	4979	41466	2121
	5228	41354	2125
	5477	41247	2124
	5726	41136	2123
	5975	41026	2124
	6223	40922	2137
	6472	40819	2166
	6721	40726	2188
	6970	40649	2209
	7219	40583	2293
	7468	40462	2278
	7717	40294	2248
	7966	40155	2248
	8215	40037	2316
	8464	39962	2364
	8713	39897	2382
	8962	39833	2375
	9211	39766	2381
	9460	39689	2387
	9709	39608	2395
	9958	39518	2396
	10207	39413	2364
	10455	39289	2292
	10704	39148	2184
	10953	39010	2066
	11202	38903	2015
	11451	38822	2014
	11700	38741	2000
	11949	38676	1998
	12198	38618	2013
	12447	38560	2001
	12696	38507	2010
	12945	38455	2015
	13194	38406	2033
	13443	38356	2037
	13692	38307	2031
	13941	38263	2038
	14190	38222	2046
	14438	38182	2052
	14687	38143	2066
	14936	38107	2078
	15185	38073	2083
	15434	38038	2141
	15683	38009	2200
	15932	37970	2203
	16181	37939	2215
	16430	37910	2229
	16679	37881	2245
	16928	37852	2239
	17177	37819	2222
	17426	37781	2200
	17675	37743	2178
	17924	37706	2164
	18173	37665	2155
	18422	37625	2147
	18670	37584	2122
	18919	37538	2106
	19168	37498	2096
	19417	37468	2107
	19666	37433	2121
	19915	37394	2109
	20164	37343	2095
	20413	37286	2115
	20662	37224	2134
	20911	37160	2131
	21160	37093	2141
	21409	37011	2148
	21658	36947	2146
	21907	36927	2172
	22156	36919	2220
	22405	36906	2277
	22653	36888	2333
	22902	36860	2379
	23151	36782	2433
	23400	36498	2389
	23649	35994	2428
	23898	35311	2550
	24147	34305	2826
	24396	32355	9300
	24645	31677	11858
	>;
	battery_profile_t2_num = <100>;
	battery_profile_t2 =
	<
	0	43768	10278
	249	43612	10278
	498	43467	10319
	747	43322	10299
	996	43187	10258
	1245	43053	10194
	1494	42924	10150
	1743	42801	10097
	1992	42679	10039
	2240	42558	9972
	2489	42438	9894
	2738	42321	9853
	2987	42201	9784
	3236	42085	9726
	3485	41970	9655
	3734	41867	9613
	3983	41757	9583
	4232	41642	9527
	4481	41531	9469
	4730	41421	9421
	4979	41311	9367
	5228	41201	9329
	5477	41092	9278
	5726	40995	9240
	5975	40914	9246
	6223	40837	9274
	6472	40760	9310
	6721	40652	9269
	6970	40497	9178
	7219	40306	9047
	7468	40116	8917
	7717	39953	8815
	7966	39817	8740
	8215	39703	8691
	8464	39602	8647
	8713	39519	8625
	8962	39448	8610
	9211	39378	8603
	9460	39304	8576
	9709	39220	8517
	9958	39135	8478
	10207	39055	8464
	10455	38974	8415
	10704	38894	8402
	10953	38818	8400
	11202	38749	8402
	11451	38679	8387
	11700	38620	8397
	11949	38558	8400
	12198	38503	8422
	12447	38451	8453
	12696	38399	8490
	12945	38347	8517
	13194	38297	8531
	13443	38251	8551
	13692	38207	8585
	13941	38166	8624
	14190	38127	8657
	14438	38092	8702
	14687	38058	8760
	14936	38022	8786
	15185	37988	8816
	15434	37958	8844
	15683	37925	8874
	15932	37898	8893
	16181	37875	8925
	16430	37855	8969
	16679	37841	9028
	16928	37824	9094
	17177	37806	9162
	17426	37790	9243
	17675	37768	9316
	17924	37751	9396
	18173	37727	9512
	18422	37704	9657
	18670	37675	9771
	18919	37641	9928
	19168	37607	10087
	19417	37567	10267
	19666	37519	10467
	19915	37463	10678
	20164	37408	10926
	20413	37351	11208
	20662	37287	11514
	20911	37217	11866
	21160	37138	12269
	21409	37069	12714
	21658	37024	13223
	21907	36996	13863
	22156	36973	14601
	22405	36944	15352
	22653	36905	16142
	22902	36835	16854
	23151	36624	17417
	23400	36215	17867
	23649	35603	18455
	23898	34711	19329
	24147	33166	50759
	24396	32217	80528
	24645	32217	80528
	>;
	battery_profile_t3_num = <100>;
	battery_profile_t3 =
	<
	0	43799	0
	249	43539	10
	498	43300	21
	747	43078	31
	996	42872	42
	1245	42686	52
	1494	42507	62
	1743	42341	73
	1992	42187	83
	2240	42042	94
	2489	41901	104
	2738	41760	115
	2987	41628	125
	3236	41499	135
	3485	41362	146
	3734	41240	156
	3983	41131	167
	4232	41031	177
	4481	40933	187
	4730	40821	198
	4979	40690	208
	5228	40536	219
	5477	40365	229
	5726	40191	239
	5975	40033	250
	6223	39894	260
	6472	39772	271
	6721	39665	281
	6970	39574	292
	7219	39493	302
	7468	39424	312
	7717	39360	323
	7966	39296	333
	8215	39224	344
	8464	39148	354
	8713	39073	364
	8962	38998	375
	9211	38926	385
	9460	38856	396
	9709	38787	406
	9958	38720	416
	10207	38654	427
	10455	38587	437
	10704	38529	448
	10953	38466	458
	11202	38413	469
	11451	38361	479
	11700	38309	489
	11949	38262	500
	12198	38212	510
	12447	38167	521
	12696	38130	531
	12945	38092	541
	13194	38057	552
	13443	38028	562
	13692	38001	573
	13941	37978	583
	14190	37954	593
	14438	37926	604
	14687	37909	614
	14936	37885	625
	15185	37862	635
	15434	37839	646
	15683	37816	656
	15932	37793	666
	16181	37770	677
	16430	37747	687
	16679	37723	698
	16928	37698	708
	17177	37669	718
	17426	37640	729
	17675	37611	739
	17924	37581	750
	18173	37546	760
	18422	37506	770
	18670	37465	781
	18919	37430	791
	19168	37391	802
	19417	37350	812
	19666	37310	823
	19915	37269	833
	20164	37225	843
	20413	37182	854
	20662	37139	864
	20911	37093	875
	21160	37047	885
	21409	36997	895
	21658	36932	906
	21907	36863	916
	22156	36782	927
	22405	36679	937
	22653	36532	947
	22902	36338	958
	23151	36084	968
	23400	35728	979
	23649	35218	989
	23898	34102	1000
	24147	32899	1007
	24396	32899	1007
	24645	32899	1007
	>;
};
/*End added by shiqiang.chen.hz on 2017/12/20  added weike battery parameter */
