## kernel-4.4/arch/arm/configs/u5a_plus_orange_debug_defconfig
```kconfig
CONFIG_CROSS_COMPILE="arm-eabi-"
# CONFIG_LOCALVERSION_AUTO is not set
# CONFIG_USELIB is not set
CONFIG_AUDIT=y
CONFIG_NO_HZ=y
CONFIG_HIGH_RES_TIMERS=y
CONFIG_TASKSTATS=y
CONFIG_TASK_XACCT=y
CONFIG_TASK_IO_ACCOUNTING=y
CONFIG_IKCONFIG=y
CONFIG_IKCONFIG_PROC=y
CONFIG_LOG_BUF_SHIFT=19
CONFIG_CGROUPS=y
CONFIG_CGROUP_DEBUG=y
CONFIG_CGROUP_FREEZER=y
CONFIG_CPUSETS=y
CONFIG_CGROUP_CPUACCT=y
CONFIG_CGROUP_SCHEDTUNE=y
CONFIG_CGROUP_SCHED=y
CONFIG_RT_GROUP_SCHED=y
CONFIG_SCHED_TUNE=y
CONFIG_BLK_DEV_INITRD=y
CONFIG_CC_OPTIMIZE_FOR_SIZE=y
CONFIG_SYSCTL_SYSCALL=y
#Begin added by qian.xue for XR5765065 on 2017/12/15
#Begin modified by shiqiang.chen.hz on 20171230, temporary modification for DTV
#CONFIG_MTK_FINGERPRINT_SUPPORT=y
#End modified by shiqiang.chen.hz on 20171230, temporary modification for DTV
#Begin added by qian.xue for XR5765065 on 2017/12/15
CONFIG_EMBEDDED=y
CONFIG_PROFILING=y
CONFIG_CC_STACKPROTECTOR_STRONG=y
CONFIG_MODULES=y
CONFIG_MODULE_UNLOAD=y
CONFIG_MODVERSIONS=y
# CONFIG_BLK_DEV_BSG is not set
CONFIG_MACH_MT6739=y
CONFIG_ARM_KERNMEM_PERMS=y
CONFIG_SMP=y
CONFIG_SCHED_MC=y
CONFIG_HAVE_ARM_ARCH_TIMER=y
CONFIG_NR_CPUS=10
CONFIG_ARM_PSCI=y
CONFIG_PREEMPT=y
CONFIG_AEABI=y
CONFIG_HIGHMEM=y
# CONFIG_HIGHPTE is not set
CONFIG_ARM_MODULE_PLTS=y
#Begin Added by Huasheng.Qiu for Task 5638921 Config for AGO on 20180104
# CONFIG_KSM is not set
#CONFIG_KSM=y
#End Added by Huasheng.Qiu for Task 5638921 Config for AGO on 20180104
CONFIG_ZSMALLOC=y
CONFIG_SECCOMP=y
CONFIG_BUILD_ARM_APPENDED_DTB_IMAGE=y
CONFIG_BUILD_ARM_APPENDED_DTB_IMAGE_NAMES="mt6739"
CONFIG_BUILD_ARM_DTB_OVERLAY_IMAGE_NAMES="u5a_plus_orange"
CONFIG_CMDLINE="console=tty0 console=ttyMT3,921600n1 root=/dev/ram vmalloc=496M slub_max_order=0 slub_debug=O "
CONFIG_CPU_FREQ=y
CONFIG_CPU_FREQ_STAT_DETAILS=y
CONFIG_CPU_FREQ_DEFAULT_GOV_INTERACTIVE=y
CONFIG_CPU_FREQ_GOV_PERFORMANCE=y
CONFIG_CPU_FREQ_GOV_POWERSAVE=y
CONFIG_CPU_FREQ_GOV_USERSPACE=y
CONFIG_CPU_FREQ_GOV_ONDEMAND=y
CONFIG_VFP=y
CONFIG_NEON=y
# CONFIG_CORE_DUMP_DEFAULT_ELF_HEADERS is not set
CONFIG_PM_AUTOSLEEP=y
CONFIG_PM_WAKELOCKS=y
CONFIG_WQ_POWER_EFFICIENT_DEFAULT=y
CONFIG_NET=y
CONFIG_PACKET=y
CONFIG_UNIX=y
CONFIG_XFRM_MIGRATE=y
CONFIG_NET_KEY=y
CONFIG_INET=y
CONFIG_IP_MULTICAST=y
CONFIG_IP_ADVANCED_ROUTER=y
CONFIG_IP_MULTIPLE_TABLES=y
CONFIG_IP_PNP=y
CONFIG_IP_PNP_DHCP=y
CONFIG_IP_PNP_BOOTP=y
CONFIG_NET_IPIP=y
CONFIG_IP_MROUTE=y
CONFIG_IP_MROUTE_MULTIPLE_TABLES=y
CONFIG_IP_PIMSM_V1=y
CONFIG_IP_PIMSM_V2=y
CONFIG_SYN_COOKIES=y
CONFIG_INET_AH=y
CONFIG_INET_ESP=y
CONFIG_INET_IPCOMP=y
# CONFIG_INET_LRO is not set
CONFIG_INET_DIAG_DESTROY=y
CONFIG_IPV6_ROUTER_PREF=y
CONFIG_IPV6_ROUTE_INFO=y
CONFIG_IPV6_OPTIMISTIC_DAD=y
CONFIG_INET6_AH=y
CONFIG_INET6_ESP=y
CONFIG_INET6_IPCOMP=y
CONFIG_IPV6_MIP6=y
CONFIG_INET6_XFRM_MODE_ROUTEOPTIMIZATION=y
CONFIG_IPV6_SIT_6RD=y
CONFIG_IPV6_MULTIPLE_TABLES=y
CONFIG_IPV6_SUBTREES=y
CONFIG_IPV6_MROUTE=y
CONFIG_IPV6_PIMSM_V2=y
CONFIG_NETFILTER=y
CONFIG_BRIDGE_NETFILTER=y
CONFIG_NF_CONNTRACK=y
CONFIG_NF_CONNTRACK_SECMARK=y
CONFIG_NF_CONNTRACK_EVENTS=y
CONFIG_NF_CT_PROTO_DCCP=y
CONFIG_NF_CT_PROTO_SCTP=y
CONFIG_NF_CT_PROTO_UDPLITE=y
CONFIG_NF_CONNTRACK_AMANDA=y
CONFIG_NF_CONNTRACK_FTP=y
CONFIG_NF_CONNTRACK_H323=y
CONFIG_NF_CONNTRACK_IRC=y
CONFIG_NF_CONNTRACK_NETBIOS_NS=y
CONFIG_NF_CONNTRACK_PPTP=y
CONFIG_NF_CONNTRACK_SANE=y
CONFIG_NF_CONNTRACK_TFTP=y
CONFIG_NF_CT_NETLINK=y
CONFIG_NETFILTER_XT_TARGET_CLASSIFY=y
CONFIG_NETFILTER_XT_TARGET_CONNMARK=y
CONFIG_NETFILTER_XT_TARGET_CONNSECMARK=y
CONFIG_NETFILTER_XT_TARGET_IDLETIMER=y
CONFIG_NETFILTER_XT_TARGET_MARK=y
CONFIG_NETFILTER_XT_TARGET_NFLOG=y
CONFIG_NETFILTER_XT_TARGET_NFQUEUE=y
CONFIG_NETFILTER_XT_TARGET_TPROXY=y
CONFIG_NETFILTER_XT_TARGET_TRACE=y
CONFIG_NETFILTER_XT_TARGET_SECMARK=y
CONFIG_NETFILTER_XT_TARGET_TCPMSS=y
CONFIG_NETFILTER_XT_MATCH_COMMENT=y
CONFIG_NETFILTER_XT_MATCH_CONNBYTES=y
CONFIG_NETFILTER_XT_MATCH_CONNLIMIT=y
CONFIG_NETFILTER_XT_MATCH_CONNMARK=y
CONFIG_NETFILTER_XT_MATCH_CONNTRACK=y
CONFIG_NETFILTER_XT_MATCH_HASHLIMIT=y
CONFIG_NETFILTER_XT_MATCH_HELPER=y
CONFIG_NETFILTER_XT_MATCH_IPRANGE=y
CONFIG_NETFILTER_XT_MATCH_LENGTH=y
CONFIG_NETFILTER_XT_MATCH_LIMIT=y
CONFIG_NETFILTER_XT_MATCH_MAC=y
CONFIG_NETFILTER_XT_MATCH_MARK=y
CONFIG_NETFILTER_XT_MATCH_MULTIPORT=y
CONFIG_NETFILTER_XT_MATCH_POLICY=y
CONFIG_NETFILTER_XT_MATCH_PHYSDEV=y
CONFIG_NETFILTER_XT_MATCH_PKTTYPE=y
CONFIG_NETFILTER_XT_MATCH_QTAGUID=y
CONFIG_NETFILTER_XT_MATCH_QUOTA=y
CONFIG_NETFILTER_XT_MATCH_QUOTA2=y
CONFIG_NETFILTER_XT_MATCH_QUOTA2_LOG=y
CONFIG_NETFILTER_XT_MATCH_REALM=y
CONFIG_NETFILTER_XT_MATCH_RECENT=y
CONFIG_NETFILTER_XT_MATCH_SOCKET=y
CONFIG_NETFILTER_XT_MATCH_STATE=y
CONFIG_NETFILTER_XT_MATCH_STATISTIC=y
CONFIG_NETFILTER_XT_MATCH_STRING=y
CONFIG_NETFILTER_XT_MATCH_TCPMSS=y
CONFIG_NETFILTER_XT_MATCH_TIME=y
CONFIG_NETFILTER_XT_MATCH_U32=y
CONFIG_NF_CONNTRACK_IPV4=y
CONFIG_IP_NF_IPTABLES=y
CONFIG_IP_NF_MATCH_AH=y
CONFIG_IP_NF_MATCH_ECN=y
CONFIG_IP_NF_MATCH_TTL=y
CONFIG_IP_NF_FILTER=y
CONFIG_IP_NF_TARGET_REJECT=y
CONFIG_IP_NF_NAT=y
CONFIG_IP_NF_TARGET_MASQUERADE=y
CONFIG_IP_NF_TARGET_NETMAP=y
CONFIG_IP_NF_TARGET_REDIRECT=y
CONFIG_IP_NF_MANGLE=y
CONFIG_IP_NF_RAW=y
CONFIG_IP_NF_SECURITY=y
CONFIG_IP_NF_ARPTABLES=y
CONFIG_IP_NF_ARPFILTER=y
CONFIG_IP_NF_ARP_MANGLE=y
CONFIG_NF_CONNTRACK_IPV6=y
CONFIG_IP6_NF_IPTABLES=y
CONFIG_IP6_NF_MATCH_FRAG=y
CONFIG_IP6_NF_MATCH_IPV6HEADER=y
CONFIG_IP6_NF_MATCH_RPFILTER=y
CONFIG_IP6_NF_TARGET_HL=y
CONFIG_IP6_NF_FILTER=y
CONFIG_IP6_NF_TARGET_REJECT=y
CONFIG_IP6_NF_MANGLE=y
CONFIG_IP6_NF_RAW=y
CONFIG_BRIDGE=y
CONFIG_VLAN_8021Q=y
CONFIG_NET_SCHED=y
CONFIG_NET_SCH_HTB=y
CONFIG_NET_SCH_INGRESS=y
CONFIG_NET_CLS_FW=y
CONFIG_NET_CLS_U32=y
CONFIG_CLS_U32_PERF=y
CONFIG_CLS_U32_MARK=y
CONFIG_NET_CLS_FLOW=y
CONFIG_NET_EMATCH=y
CONFIG_NET_EMATCH_U32=y
CONFIG_NET_CLS_ACT=y
CONFIG_NET_ACT_POLICE=y
CONFIG_NET_ACT_MIRRED=y
CONFIG_NET_ACT_IPT=y
CONFIG_NET_CLS_IND=y
CONFIG_CFG80211=y
CONFIG_NL80211_TESTMODE=y
CONFIG_CFG80211_DEVELOPER_WARNINGS=y
# CONFIG_CFG80211_DEFAULT_PS is not set
CONFIG_CFG80211_DEBUGFS=y
CONFIG_CFG80211_INTERNAL_REGDB=y
CONFIG_MTK_NET_LOGGING=y
CONFIG_ZRAM=y
CONFIG_ZRAM_LZ4_COMPRESS=y
CONFIG_ZRAM_LZ4K_COMPRESS=y
CONFIG_BLK_DEV_LOOP=y
CONFIG_UID_SYS_STATS=y
CONFIG_MEDIATEK_SOLUTION=y
CONFIG_MTK_PLATFORM="mt6739"
CONFIG_ARCH_MTK_PROJECT="u5a_plus_orange"
CONFIG_MTK_ENG_BUILD=y
# CONFIG_TARGET_COPY_OUT_ODM is not set
CONFIG_MTK_SHARED_SDCARD=y
CONFIG_MTK_GPT_SCHEME_SUPPORT=y
CONFIG_MTK_UNIFY_POWER=y
CONFIG_MTK_FREQ_HOPPING=y
CONFIG_MTK_PMIC_NEW_ARCH=y
CONFIG_MTK_PMIC_COMMON=y
CONFIG_MTK_PMIC_CHIP_MT6357=y
CONFIG_MTK_AUXADC_INTF=y
# CONFIG_MTK_PMIC is not set
CONFIG_MTK_THERMAL_PA_VIA_ATCMD=y
#Begin modified by zhanyong.yin for XR5301378 on 2017/10/19
#begin, modify by zhijun.fu for imgsensor on 2017-12-28
CONFIG_CUSTOM_KERNEL_IMGSENSOR="a3a_hi1333_mipi_raw a3a_hi556_mipi_raw a3a_gc5025_mipi_raw hi846_mipi_raw hi846_brodsands_mipi_raw gc8034_mipi_raw gc5025_cxt_mipi_raw"
#CONFIG_MTK_LENS_DW9800AF_SUPPORT=y
#CONFIG_MTK_LENS_DW9814AF_SUPPORT=y
CONFIG_MTK_LENS_FP5510AF_SUPPORT=y
CONFIG_MTK_LENS_DW9714AF_SUPPORT=y
CONFIG_MTK_LENS_CN3927AF_SUPPORT=y
#end, modify by zhijun.fu for imgsensor on 2017-12-16
#End modified by zhanyong.yin for XR5301378 on 2017/10/19
#begin modify by zhijun.fu for eeprom on 2017-12-28
CONFIG_CUSTOM_KERNEL_CAM_CAL_DRV="BRCB032GWZ_3 GT24c32a cat24c16 fm24c64d hi846otp"
#begin, modify by zhijun.fu for imgsensor on 2017-12-28
# Begin added by yang.liu.hz for FR5597245 on 20171101,add new lcm driver.
# CONFIG_MTK_LCM_PHYSICAL_ROTATION_HW is not set
# End added by yang.liu.hz for FR5597245 on 20171101,add new lcm driver.
# CONFIG_MTK_CAMERA_ISP is not set
CONFIG_MTK_CAM_CAL=y
CONFIG_MTK_CMDQ=y
CONFIG_MTK_FLASHLIGHT=y
#Begin modified by zhanyong.yin for XR5301378 on 2017/10/19
#CONFIG_MTK_FLASHLIGHT_RT4505=y
#begin, modify by zhijun.fu for imgsensor on 2017-12-28
#CONFIG_MTK_FLASHLIGHT_LED191=y
CONFIG_MTK_FLASHLIGHT_LED2601_REAR=y
CONFIG_MTK_FLASHLIGHT_LED2601_FRONT=y
#end, modify by zhijun.fu for imgsensor on 2017-12-28
#Begin modified by shiqiang.chen.hz on 20171230, temporary modification for DTV
#CONFIG_MTK_FLASHLIGHT_LM3642=y
#End modified by shiqiang.chen.hz on 20171230, temporary modification for DTV
#CONFIG_MTK_FLASHLIGHT_PT=y
#CONFIG_MTK_FLASHLIGHT_PT_STRICT=y
#CONFIG_MTK_FLASHLIGHT_DLPT=y
#End modified by zhanyong.yin for XR5301378 on 2017/10/19
CONFIG_MTK_GPU_SUPPORT=y
CONFIG_MTK_GPU_VERSION="rgx auckland 1.8ED"
CONFIG_MTK_GPU_COMMON_DVFS_SUPPORT=y
CONFIG_MTK_IMGSENSOR=y
CONFIG_MTK_JPEG=y
CONFIG_MTK_LCM=y
#/*** begin: add by liuhe.zhong for jd9161 lcm driver on 2017.12.7 ***/
CONFIG_CUSTOM_KERNEL_LCM="u5aplus_ili9806e_fwvga_dsi_vdo_holitech_sm5109 u5aplus_jd9161_fwvga_dsi_vdo_skyworth"
#/*** end:   add by liuhe.zhong for jd9161 lcm driver on 2017.12.7 ***/
#Begin Added by meng.zhang for task 5495837 on 2017/10/31 
CONFIG_MTK_ROUND_CORNER_SUPPORT=y
#End Added by meng.zhang for task 5495837 on 2017/10/31
CONFIG_MTK_LENS=y
# CONFIG_MMPROFILE is not set
CONFIG_MTK_SYNC=y
CONFIG_MTK_VIDEOCODEC_DRIVER=y
CONFIG_MTK_FB=y
CONFIG_MTK_LCM_PHYSICAL_ROTATION="0"
CONFIG_LCM_HEIGHT="960"
CONFIG_LCM_WIDTH="480"
#End modified by longfang.liu for XR5424727 on 2017/10/23
CONFIG_MTK_AAL_SUPPORT=y
CONFIG_MTK_DYNAMIC_FPS_FRAMEWORK_SUPPORT=y
#Begin modified by lanying.he for XR5424729 on 2017/10/20 sensor driver
CONFIG_MTK_SENSOR_SUPPORT=y
CONFIG_MTK_SENSORS_1_0=y
#Begin modified by yan.gong for XR6019929 on 2018/2/27 sensor driver
CONFIG_CUSTOM_KERNEL_SIGNIFICANT_MOTION_SENSOR=y
CONFIG_MTK_SIGNIFICANT_SENSOR=y
#End modified by yan.gong for XR6019929 on 2018/2/27 sensor driver
CONFIG_CUSTOM_KERNEL_ACCELEROMETER=y
#Add by zhi.chen.hz for u5a bma253 and KXTJ2
#CONFIG_MTK_A3A_MC3413_P is not set 
#CONFIG_MTK_A3A_BMA253_NEW is not set 
CONFIG_MTK_U5A_BMA2X2=y
CONFIG_MTK_U5A_KXTJ2=y
#End by zhi.chen.hz for u5a bma253 and KXTJ2
CONFIG_CUSTOM_KERNEL_ALSPS=y
#Begin add by zhi.chen for u5a_ltr578 2017/12/15
#CONFIG_MTK_A3A_STK3X1X_S34 is not set 
CONFIG_MTK_U5A_LTR578=y
CONFIG_MTK_U5A_STK3X1X=y
#End add by zhi.chen for u5a_ltr578 2017/12/15
#Begin modified by lanying.he for XR5756987 orientation 
#CONFIG_CUSTOM_KERNEL_GYROSCOPE is not set //delete by zhi.chen for CTS test
#Begin modified by lanying.he for XR5756987 orientation 
#CONFIG_MTK_A3A_BMG250=y
#Begin delete by zhi.chen for CTS test
#CONFIG_CUSTOM_KERNEL_MAGNETOMETER is not set
#CONFIG_MTK_A3A_AKM09918 is not set
#End delete by zhi.chen for CTS test
CONFIG_MTK_HWMON=y
#Begin deleted by lanying.he for XR5769570  
#CONFIG_CUSTOM_KERNEL_BAROMETER=y
#CONFIG_MTK_BMP280_NEW=y
#End deleted by lanying.he for XR5769570  
#End modified by lanying.he for XR5424729 on 2017/10/20 sensor driver
CONFIG_MTK_BTIF=y
#Modified by wzhang for task 5539327 (set to 4 mode) on 2017.11.01 begin 
CONFIG_MTK_MD1_SUPPORT=9
#Modified by wzhang for task 5539327 (set to 4 mode) on 2017.11.01 end 
#Modified by wzhang for task 5539327 (set to 4 mode) on 2017.11.01 end
# modified by wzhang for task 5363446 on 2017.09.27 begin
CONFIG_MTK_C2K_LTE_MODE=0
# modified by wzhang for task 5363446 on 2017.09.27 end
# modified by wzhang for task 5363446 on 2017.09.27 begin
CONFIG_MTK_MD3_SUPPORT=0
# modified by wzhang for task 5363446 on 2017.09.27 end
CONFIG_MTK_COMBO=y
CONFIG_MTK_COMBO_CHIP_CONSYS_6739=y
CONFIG_MTK_COMBO_BT=y
CONFIG_MTK_COMBO_GPS=y
CONFIG_MTK_COMBO_WIFI=y
# CONFIG_MTK_WAPI_SUPPORT is not set
CONFIG_MTK_DHCPV6C_WIFI=y
CONFIG_MTK_GPS_SUPPORT=y
CONFIG_MTK_FMRADIO=y
CONFIG_MTK_FM_CHIP="MT6625_FM"
CONFIG_MTK_ECCCI_DRIVER=y
CONFIG_MTK_ECCCI_C2K=y
CONFIG_MTK_ACCDET=y
# Begin Modified by meng.zhang for task 5424730 on 2017/10/21 
#CONFIG_ACCDET_EINT_IRQ is not set
CONFIG_ACCDET_EINT=y
#CONFIG_JRD_HAC_EXTERNAL_PA_SUPPORT is not set
#jingdong,delete for u5a different with a3a,2018,3,1
# End Modified by meng.zhang for task 5424730 on 2017/10/21 
CONFIG_ACCDET_SUPPORT_EINT0=y
CONFIG_MTK_DEVAPC_DRIVER=y
CONFIG_MTK_DRAMC=y
# CONFIG_MTK_EMI_MBW is not set
# CONFIG_MTK_GPIO is not set
CONFIG_MTK_GPIOLIB_STAND=y
CONFIG_MTK_LEDS=y
CONFIG_MTK_PWM=y
CONFIG_MTK_RTC=y
CONFIG_MTK_SMI_EXT=y
CONFIG_USB_MTK_HDRC=y
CONFIG_MTK_MUSB_QMU_SUPPORT=y
CONFIG_MTK_MUSB_QMU_PURE_ZLP_SUPPORT=y
CONFIG_USB_MTK_OTG=y
CONFIG_MTK_VIBRATOR=y
CONFIG_MTK_FPSGO=y
CONFIG_MTK_FPSGO_FBT_GAME=y
CONFIG_MTK_FPSGO_FBT_UX=y
CONFIG_MTK_FPSGO_FSTB=y
CONFIG_MTK_MEMCFG=y
CONFIG_MTK_AEE_FEATURE=y
CONFIG_MTK_AEE_MRDUMP=y
CONFIG_MTK_CHIP=y
CONFIG_MTK_DRAM_LOG_STORE=y
CONFIG_MTK_DRAM_LOG_STORE_ADDR=0x0010E900
CONFIG_MTK_DRAM_LOG_STORE_SIZE=0x100
CONFIG_MTPROF=y
CONFIG_MTK_SCHED_MONITOR=y
CONFIG_PREEMPT_MONITOR=y
CONFIG_MTK_WQ_DEBUG=y
CONFIG_MTK_RCU_MONITOR=y
CONFIG_MTK_RAM_CONSOLE=y
CONFIG_MTK_RAM_CONSOLE_USING_SRAM=y
CONFIG_MTK_RAM_CONSOLE_SIZE=0x800
CONFIG_MTK_RAM_CONSOLE_ADDR=0x0010DC00
CONFIG_MTK_RAM_CONSOLE_DRAM_SIZE=0x10000
CONFIG_MTK_RAM_CONSOLE_DRAM_ADDR=0x44400000
CONFIG_MTK_CPU_AFFINITY=y
CONFIG_MTK_LOAD_BALANCE_ENHANCEMENT=y
CONFIG_MTK_SCHED_INTEROP=y
CONFIG_MTK_SCHED_TRACE=y
CONFIG_MTK_RT_THROTTLE_MON=y
CONFIG_MTK_CPU_TOPOLOGY=y
CONFIG_MTK_SCHED_RQAVG_KS=y
CONFIG_MTK_SCHED_RQAVG_US=y
CONFIG_MTK_SCHED_CPULOAD=y
CONFIG_MTK_SCHED_EAS_PLUS=y
CONFIG_MTK_SCHED_EAS_POWER_SUPPORT=y
CONFIG_MTK_SCHED_VIP_TASKS=y
CONFIG_CPU_FREQ_GOV_SCHEDPLUS=y
CONFIG_SCHED_HMP=y
CONFIG_SCHED_HMP_PRIO_FILTER=y
CONFIG_HMP_TRACER=y
CONFIG_SCHED_HMP_PLUS=y
CONFIG_MTK_SYSENV=y
CONFIG_RT_REGMAP=y
CONFIG_MTK_ACAO_SUPPORT=y
CONFIG_SCSI=y
CONFIG_BLK_DEV_SD=y
CONFIG_SCSI_SCAN_ASYNC=y
# CONFIG_SCSI_LOWLEVEL is not set
CONFIG_MD=y
CONFIG_BLK_DEV_DM=y
CONFIG_DM_DEBUG=y
CONFIG_DM_CRYPT=y
CONFIG_DM_UEVENT=y
CONFIG_DM_VERITY=y
CONFIG_DM_VERITY_FEC=y
CONFIG_NETDEVICES=y
CONFIG_IFB=y
CONFIG_TUN=y
# CONFIG_ETHERNET is not set
CONFIG_PPP=y
CONFIG_PPP_BSDCOMP=y
CONFIG_PPP_DEFLATE=y
CONFIG_PPP_FILTER=y
CONFIG_PPP_MPPE=y
CONFIG_PPP_MULTILINK=y
CONFIG_PPPOE=y
CONFIG_PPPOLAC=y
CONFIG_PPPOPNS=y
CONFIG_PPP_ASYNC=y
CONFIG_PPP_SYNC_TTY=y
# CONFIG_INPUT_MOUSEDEV is not set
CONFIG_INPUT_EVDEV=y
CONFIG_KEYBOARD_MTK=y
CONFIG_ONEKEY_REBOOT_NORMAL_MODE=y
CONFIG_ONEKEY_REBOOT_OTHER_MODE=y
CONFIG_KPD_PWRKEY_USE_PMIC=y
CONFIG_KEYBOARD_MTK_PMIC=y
# CONFIG_INPUT_MOUSE is not set
CONFIG_INPUT_TOUCHSCREEN=y
CONFIG_TOUCHSCREEN_MTK=y
# Begin added and deleted by yang.liu.hz for FR5597245 on 20171115,add CTP drivers.
CONFIG_TOUCHSCREEN_MTK_U5APLUS_MSG22XX=y
# End added adn deleted by yang.liu.hz for FR5597245 on 20171115,add CTP drivers.
#*** add for focaltech touch panel driver, 2017.12.06 , zlh ***
CONFIG_TOUCHSCREEN_MTK_FOCALTECH_TS=y
#**************************************************************
CONFIG_INPUT_MISC=y
CONFIG_INPUT_UINPUT=y
# CONFIG_VT is not set
CONFIG_LEGACY_PTY_COUNT=16
# CONFIG_DEVMEM is not set
# CONFIG_DEVKMEM is not set
# CONFIG_HW_RANDOM is not set
CONFIG_SPI=y
CONFIG_SPI_MT65XX=y
#Begin added by zhihua.fang for u5a fingerprint on 2017/11/17
CONFIG_MTK_FINGERPRINT_SUPPORT=y
CONFIG_FPSENSOR_FINGERPRINT_MTK_U5APLUS_ICNT7151=y
#end added by zhihua.fang for u5a fingerprint on 2017/11/17
CONFIG_FPSENSOR_FINGERPRINT_MTK_U5APLUS_ICNT7151=y
#end added by zhihua.fang for u5a fingerprint on 2017/11/17

CONFIG_POWER_SUPPLY=y
#Begin modified by shiqiang.chen.hz for FR5597245 on 20171117,for linearCharger
# Modified by rongxiao.deng for 5424735 porting charging function begin
# CONFIG_CHARGER_RT9458=y
# CONFIG_CHARGER_BQ24157=y
# CONFIG_CHARGER_PSC5415A=y
# Modified by rongxiao.deng for 5424735 porting charging function end
CONFIG_MTK_SMART_BATTERY=y
#CONFIG_MTK_SWCHR_SUPPORT=y
#End modified by shiqiang.chen.hz for FR5597245 on 20171117,for linearCharger
CONFIG_MTK_KERNEL_POWER_OFF_CHARGING=y
CONFIG_MTK_GAUGE_VERSION=30
# CONFIG_HWMON is not set
CONFIG_THERMAL=y
CONFIG_THERMAL_DEFAULT_GOV_BACKWARD_COMPATIBLE=y
CONFIG_WATCHDOG=y
CONFIG_MTK_WATCHDOG_COMMON=y
CONFIG_MTK_WATCHDOG_COMMON_V2=y
CONFIG_REGULATOR=y
CONFIG_DRM=y
CONFIG_FB_MODE_HELPERS=y
CONFIG_FB_TILEBLITTING=y
CONFIG_LOGO=y
CONFIG_SOUND=y
CONFIG_SND=y
CONFIG_SND_SEQUENCER=y
CONFIG_SND_SEQ_DUMMY=y
CONFIG_SND_SEQUENCER_OSS=y
CONFIG_SND_HRTIMER=y
CONFIG_SND_DYNAMIC_MINORS=y
# CONFIG_SND_SPI is not set
CONFIG_SND_USB_AUDIO=y
CONFIG_MTK_UAC_POWER_SAVING=y
CONFIG_SND_SOC=y
CONFIG_MTK_SND_SOC_CODEC="mt6357"
CONFIG_SND_SOC_MTK_BTCVSD=y
CONFIG_MTK_SND_SOC_NEW_ARCH=y
CONFIG_SOUND_PRIME=y
CONFIG_HIDRAW=y
CONFIG_UHID=y
CONFIG_HID_A4TECH=y
CONFIG_HID_APPLE=y
CONFIG_HID_BELKIN=y
CONFIG_HID_CHERRY=y
CONFIG_HID_CHICONY=y
CONFIG_HID_CYPRESS=y
CONFIG_HID_DRAGONRISE=y
CONFIG_HID_EZKEY=y
CONFIG_HID_KYE=y
CONFIG_HID_GYRATION=y
CONFIG_HID_TWINHAN=y
CONFIG_HID_KENSINGTON=y
CONFIG_HID_LOGITECH=y
CONFIG_HID_MAGICMOUSE=y
CONFIG_HID_MICROSOFT=y
CONFIG_HID_MONTEREY=y
CONFIG_HID_PANTHERLORD=y
CONFIG_HID_PETALYNX=y
CONFIG_HID_SAMSUNG=y
CONFIG_HID_SUNPLUS=y
CONFIG_HID_GREENASIA=y
CONFIG_HID_SMARTJOYPLUS=y
CONFIG_HID_TOPSEED=y
CONFIG_HID_THRUSTMASTER=y
CONFIG_HID_ZEROPLUS=y
CONFIG_USB=y
CONFIG_USB_STORAGE=y
CONFIG_USB_STORAGE_DATAFAB=y
CONFIG_USB_STORAGE_FREECOM=y
CONFIG_USB_STORAGE_ISD200=y
CONFIG_USB_STORAGE_USBAT=y
CONFIG_USB_STORAGE_SDDR09=y
CONFIG_USB_STORAGE_SDDR55=y
CONFIG_USB_STORAGE_JUMPSHOT=y
CONFIG_USB_STORAGE_ALAUDA=y
CONFIG_USB_STORAGE_ONETOUCH=y
CONFIG_USB_STORAGE_KARMA=y
CONFIG_USB_STORAGE_CYPRESS_ATACB=y
CONFIG_USB_SERIAL=y
CONFIG_USB_TRANCEVIBRATOR=y
CONFIG_NOP_USB_XCEIV=y
CONFIG_USB_GADGET=y
CONFIG_USB_GADGET_VBUS_DRAW=500
CONFIG_USB_CONFIGFS=y
CONFIG_USB_CONFIGFS_SERIAL=y
CONFIG_USB_CONFIGFS_ACM=y
CONFIG_USB_CONFIGFS_RNDIS=y
CONFIG_USB_CONFIGFS_MASS_STORAGE=y
CONFIG_USB_CONFIGFS_F_FS=y
CONFIG_USB_CONFIGFS_F_MTP=y
CONFIG_USB_CONFIGFS_F_PTP=y
CONFIG_USB_CONFIGFS_F_ACC=y
CONFIG_USB_CONFIGFS_F_AUDIO_SRC=y
CONFIG_USB_CONFIGFS_UEVENT=y
CONFIG_USB_CONFIGFS_F_MIDI=y
CONFIG_USB_CONFIGFS_F_HID=y
CONFIG_MMC=y
CONFIG_MMC_BLOCK_MINORS=32
CONFIG_MMC_MTK_PRO=y
CONFIG_MTK_EMMC_SUPPORT=y
CONFIG_MTK_EMMC_CACHE=y
# Begin modified by fengke in task 6139016_6601872_6551385 for CQ and launch boost 2018.07.24
# CONFIG_MTK_EMMC_CQ_SUPPORT is not set
# End modified by fengke in task 6139016_6601872_6551385 for CQ and launch boost 2018.07.24
# Task5424689 added by jia.zhang to support otp begin
CONFIG_MTK_EMMC_SUPPORT_OTP=y
# Task5424689 added by jia.zhang to support otp end
CONFIG_NEW_LEDS=y
CONFIG_LEDS_CLASS=y
CONFIG_LEDS_TRIGGERS=y
CONFIG_LEDS_TRIGGER_TIMER=y
CONFIG_SWITCH=y
CONFIG_RTC_CLASS=y
CONFIG_STAGING=y
CONFIG_ASHMEM=y
#Keep CONFIG_ANDROID_LOW_MEMORY_KILLER for MTK Defect 5818329
CONFIG_ANDROID_LOW_MEMORY_KILLER=y
CONFIG_ANDROID_INTF_ALARM_DEV=y
CONFIG_SYNC=y
CONFIG_SW_SYNC=y
CONFIG_SW_SYNC_USER=y
CONFIG_ION=y
CONFIG_MTK_ION=y
# CONFIG_IOMMU_SUPPORT is not set
CONFIG_ANDROID=y
CONFIG_ANDROID_BINDER_IPC=y
CONFIG_EXT4_FS=y
CONFIG_EXT4_FS_SECURITY=y
CONFIG_EXT4_DEBUG=y
#Task5354494 added file lock patch by chuanbo.qiu begin
CONFIG_WIL_LOCK_FILE=y
CONFIG_FILE_LOCK_DEV=y
CONFIG_LOCK_FOR_READ=y
#Task5354494 added file lock patch by chuanbo.qiu end
CONFIG_QUOTA=y
CONFIG_QUOTA_NETLINK_INTERFACE=y
CONFIG_QFMT_V2=y
CONFIG_FUSE_FS=y
CONFIG_ISO9660_FS=y
CONFIG_JOLIET=y
CONFIG_ZISOFS=y
CONFIG_MSDOS_FS=y
CONFIG_VFAT_FS=y
CONFIG_TMPFS=y
CONFIG_SDCARD_FS=y
CONFIG_PSTORE=y
CONFIG_PSTORE_CONSOLE=y
CONFIG_PSTORE_PMSG=y
CONFIG_PSTORE_RAM=y
CONFIG_PSTORE_CONSOLE_SIZE=0x40000
CONFIG_PSTORE_PMSG_SIZE=0x10000
CONFIG_PSTORE_MEM_ADDR=0x44410000
CONFIG_PSTORE_MEM_SIZE=0xe0000
# CONFIG_NETWORK_FILESYSTEMS is not set
CONFIG_NLS_CODEPAGE_437=y
CONFIG_NLS_CODEPAGE_950=y
CONFIG_NLS_ASCII=y
CONFIG_NLS_ISO8859_1=y
CONFIG_NLS_UTF8=y
CONFIG_PRINTK_TIME=y
CONFIG_DYNAMIC_DEBUG=y
CONFIG_DEBUG_INFO=y
CONFIG_FRAME_WARN=1400
CONFIG_PAGE_OWNER=y
CONFIG_PAGE_OWNER_SLIM=y
CONFIG_SLUB_DEBUG_ON=y
CONFIG_DEBUG_KMEMLEAK=y
CONFIG_DEBUG_KMEMLEAK_EARLY_LOG_SIZE=3200
CONFIG_DEBUG_KMEMLEAK_DEFAULT_OFF=y
CONFIG_PANIC_ON_OOPS=y
CONFIG_PANIC_TIMEOUT=5
CONFIG_SCHEDSTATS=y
CONFIG_PROVE_LOCKING=y
CONFIG_DEBUG_LOCKDEP=y
CONFIG_DEBUG_ATOMIC_SLEEP=y
CONFIG_DEBUG_LIST=y
CONFIG_RCU_CPU_STALL_TIMEOUT=60
CONFIG_RCU_TRACE=y
CONFIG_FAULT_INJECTION=y
CONFIG_ENABLE_DEFAULT_TRACERS=y
CONFIG_MTK_SCHED_TRACERS=y
CONFIG_MTK_FTRACE_DEFAULT_ENABLE=y
CONFIG_DMA_API_DEBUG=y
CONFIG_KGDB=y
CONFIG_KGDB_KDB=y
# CONFIG_ARM_UNWIND is not set
CONFIG_SECURITY_PERF_EVENTS_RESTRICT=y
CONFIG_SECURITY=y
CONFIG_SECURITY_NETWORK=y
CONFIG_HARDENED_USERCOPY=y
CONFIG_SECURITY_SELINUX=y
CONFIG_SECURITY_SELINUX_BOOTPARAM=y
CONFIG_CRYPTO_TWOFISH=y
CONFIG_CRYPTO_LZO=y
# CONFIG_CRYPTO_HW is not set
CONFIG_CRYPTO_SHA512_ARM=y
# Begin add smart log by yinghe for XR5424644 on 2017-11-14
CONFIG_JRD_PRINTD=y
# End add smart log by yinghe for XR5424644 on 2017-11-14
# Begin Modified by meng.zhang for task 5424739 on 2017/10/21 
# CONFIG_NFC_PN553=y
# End Modified by meng.zhang for task 5424739 on 2017/10/21 
# Begin Modified by zhihua.fang for task 5424739 on 2017/12/265 
CONFIG_NFC_U5A_PN553=y
# End Modified by zhihua.fang for task 5424739 on 2017/12/26 
#task5424643 added by jia.zhang to control usb2uart function begin
CONFIG_MTK_UART_USB_SWITCH=y
#task5424643 added by jia.zhang to control usb2uart function end
#Begin added by lanying.he for XR5495833 on 2017/1031 robust
CONFIG_MTK_ROBUST=y
#End added by lanying.he for XR5495833 on 2017/1031 robust
# Begin added by jinhui.duan.hz for task 5597245 on 20171117,add aw87318 external audio pa driver.
CONFIG_AW87318_AUDIO_PA=y
# End added by jinhui.duan.hz for task 5597245 on 20171117,add aw87318 external audio pa driver.
# Begin added by shiqiang.chen.hz for task 5597245 on 20171117,add fc8180 dtv driver.
CONFIG_FC8180_DTV=y
# End added by shiqiang.chen.hz for task 5597245 on 20171117,add add fc8180 dtv driver.
#modify by lida for taks:5443772 to enble tee at 2017.11.22 begin
CONFIG_TRUSTONIC_TEE_SUPPORT=y
CONFIG_MTK_TEE_GP_SUPPORT=y
CONFIG_TRUSTONIC_TEE_VERSION=y
CONFIG_MOBICORE_DRIVER=y
CONFIG_MOBICORE_DEBUG=y
CONFIG_MOBICORE_VERBOSE=y
CONFIG_MOBICORE_API=y
#CONFIG_TRUSTONIC_TRUSTED_UI=y
#CONFIG_TRUSTONIC_TRUSTED_UI_FB_BLANK=y
#modify by lida for taks:5443772 to enble tee at 2017.11.22 end
#begin add by yan.fang for secure boot  20171125 task  5443775
CONFIG_MTK_SECURITY_SW_SUPPORT=y
#end add by yan.fang for secure boot 20171125 task  5443775
# Begin added by hailong.chen for XR5598906 using 4 temperature on 2017/11/24
CONFIG_MTK_ADDITIONAL_BATTERY_TABLE=n
# End added by hailong.chen for XR5598906 using 4 temperature on 2017/11/24
# Begin added by rongxiao.deng for task 5495859 on 2017/11/28
# CONFIG_SUPPORT_IEEE1725_BATTERY_CV is not set
# End added by rongxiao.deng for task 5495859 on 2017/11/28
#begin add by yan.fang for add efuse flag 20171206
CONFIG_CHECKEFUSE=y
#end add by yan.fang for add efuse flag 20171206
# Begin added by yinghe for XR5424657 on 2017/12/26
CONFIG_TCT_BIGLOG=y
# End added by yinghe for XR5424657 on 2017/12/26
#Begin Added by Huasheng.Qiu for Task 5638921 Config for AGO on 20180104
CONFIG_SWAP=y
CONFIG_CGROUP_MEM_RES_CTLR=y
CONFIG_CGROUP_MEM_RES_CTLR_SWAP=y
#CONFIG_ZRAM=y
CONFIG_MEMCG=y
CONFIG_MEMCG_SWAP=y
#CONFIG_ZRAM_LZ4_COMPRESS=y
# CONFIG_SLUB_DEBUG is not set
CONFIG_F2FS_FS=y
CONFIG_F2FS_FS_SECURITY=y
CONFIG_MTK_GMO_RAM_OPTIMIZE=y
#End Added by Huasheng.Qiu for Task 5638921 Config for AGO on 20180104
#modify 20180105 by xiaorong.ling.hz for task5854814 begin
CONFIG_MTK_DM_VERITY_OFF=y
#modify 20180105 by xiaorong.ling.hz for task5854814 end
# Begin added by qiyang.yan for fpc on 20171219
CONFIG_MTK_FINGERPRINT_SUPPORT=y
CONFIG_FPC_FINGERPRINT_TEE=y
CONFIG_INPUT_FPC1020_IRQ=y
# End added by qiyang.yan for fpc on 20171219
```
