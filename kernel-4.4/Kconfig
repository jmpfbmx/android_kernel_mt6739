## kernel-4.4/drivers/checkefuse/Kconfig
```kconfig
config CHECKEFUSE  
tristate "checkefuse status Driver"  
default n  
help  
It is a Efuse status checke driver. 
```

## kernel-4.4/drivers/input/touchscreen/mediatek/Kconfig
```kconfig
#
# Touchscreen driver configuration
#
menuconfig INPUT_TOUCHSCREEN
	bool "Touchscreens"
	help
	  Say Y here, and a list of supported touchscreens will be displayed.
	  This option doesn't affect the kernel.

	  If unsure, say Y.

if INPUT_TOUCHSCREEN

config TOUCHSCREEN_MTK
	bool "MediaTek Touch Panel Driver"
	help
	  Say Y here if you have MediaTek touch panel.

	  If unsure, say N.

	  To compile this dirver as a module, choose M here: the
	  module will be called.

config TOUCHSCREEN_PHYSICAL_ROTATION_WITH_LCM
	bool "MediaTek Touch Panel Rotation With LCM"
	default y
	help
	  Say N here if touch panel is not physical rotated as LCM does.
	  Physically rotated means that this driver will map
	  the reported coordination to diagonal position.

	  If unsure, say Y.

config TOUCHSCREEN_MTK_GT1151
	bool "GT1151 for Mediatek package"
	default n
	help
	  Say Y here if you have GT1151 touch panel.

	  If unsure, say N.

	  To compile this dirver as a module, choose M here: the
	  module will be called.

source "drivers/input/touchscreen/mediatek/GT1151/Kconfig"

# Modified by longfang.liu.hz for add new CTP driver 2017.10.23 begin
config TOUCHSCREEN_MTK_A3A_FT8613
	bool "ft8613 for Mediatek package"
	default n
	help
	  Say Y here if you have ft8613 touch panel.

	  If unsure, say N.

	  To compile this dirver as a module, choose M here: the
	  module will be called.
source "drivers/input/touchscreen/mediatek/a3a_ft8613/Kconfig"

config TOUCHSCREEN_MTK_A3A_TD4310
	bool "td4310 for Mediatek package"
	default n
	help
	  Say Y here if you have td4310 touch panel.

	  If unsure, say N.

	  To compile this dirver as a module, choose M here: the
	  module will be called.

source "drivers/input/touchscreen/mediatek/a3a_td4310/Kconfig"
# Modified by longfang.liu.hz for add new CTP driver 2017.10.23 end
config TOUCHSCREEN_MTK_GT911
	bool "GT911 for Mediatek package"
	help
	  Say Y here if you have GT911 touch panel.

	  If unsure, say N.

source "drivers/input/touchscreen/mediatek/GT911/Kconfig"

config TOUCHSCREEN_FT5X26
	bool "FT5X26 for Mediatek package"
	default n
	help
	  Say Y here if you have FT5X26 touch panel.

	  If unsure, say N.

	  To compile this dirver as a module, choose M here: the
	  module will be called.

source "drivers/input/touchscreen/mediatek/FT5X26/Kconfig"

config TOUCHSCREEN_MTK_GSLX680
	bool "gslX680 for Mediatek package"
	help
	  Say Y here if you have gslX680 touch panel.

	  If unsure, say N.

#Begin added by yang.liu.hz for FR5597245 on 20171115,add CTP drivers.
source "drivers/input/touchscreen/mediatek/u5aplus_msg22xx/Kconfig"
#End added by yang.liu.hz for FR5597245 on 20171115,add CTP drivers.
#*** add for focaltech touch panel driver, 2017.12.06 , zlh ***
source "drivers/input/touchscreen/mediatek/focaltech_touch/Kconfig"
#**************************************************************
endif
```

## kernel-4.4/drivers/input/touchscreen/mediatek/u5aplus_msg22xx/Kconfig
```kconfig
#
# Touchscreen driver configuration
#
config TOUCHSCREEN_MTK_U5APLUS_MSG22XX
    bool "MStar Ts for Mediatek"
    depends on I2C
    default n
    help
      Say Y here if you have Mstar touch panel.
      If unsure, say N.
```

## kernel-4.4/drivers/misc/mediatek/a3a_pn553/Kconfig
```kconfig
config NFC_PN553
	bool "NXP NFC driver"
	default y
	help
	  Say Y here for supporting  NXP NFC PN547 PN548 PN553.
```

## kernel-4.4/drivers/misc/mediatek/aw87318/Kconfig
```kconfig
config AW87318_AUDIO_PA
	tristate "aw87318 smart audio pa driver"
	---help---
	  aw87318 smart audio pa driver
	  If you want to use aw87318 smart audio pa driver,
	  say Y or M here.
	  If unsure, say N.
```

## kernel-4.4/drivers/misc/mediatek/fc8180/Kconfig
```kconfig
config FC8180_DTV
	tristate "fc8180 dtv driver code"
	---help---
	  fc8180 dtv driver code
	  If you want to use fc8180 dtv driver,
	  say Y or M here.
	  If unsure, say N.
```

## kernel-4.4/drivers/misc/mediatek/robust/Kconfig
```kconfig
config MTK_ROBUST
	bool "CONFIG_MTK_ROBUST for MediaTek package"
	default n
	help
	It support different type sensor
	in this platform. If this option
	is set, it will support ROBUST.
```

## kernel-4.4/drivers/misc/mediatek/sensors-1.0/accelerometer/A3A_bma253/Kconfig
```kconfig
config MTK_A3A_BMA253_NEW
	bool "MTK_A3A_BMA2XX_NEW for MediaTek package"
	default n
	
```

## kernel-4.4/drivers/misc/mediatek/sensors-1.0/accelerometer/A3A_mc3413-p/Kconfig
```kconfig
config MTK_A3A_MC3413_P
	bool "MTK_A3A_MC3413_P for MediaTek package"
	default n
	help
	  It support different accelerometer sensor.
          If this option is set,
	  it will support
          MTK_A3A_MC3413_P Accelerometer.
```

## kernel-4.4/drivers/misc/mediatek/sensors-1.0/accelerometer/Kconfig
```kconfig
config MTK_AUTO_DETECT_ACCELEROMETER
	bool "MTK AUTO DETECT ACCELEROMETER Sensor"
	depends on MTK_SENSOR_SUPPORT
	help
	  one load to support different accelerometer sensor.
	  If this option is set, multiple accelerometer driver
	  can be configured at the same time, but only one
	  can be probed.

config CUSTOM_KERNEL_ACCELEROMETER
	bool "CUSTOM KERNEL ACCELEROMETER Config"
	help
	  accelerometer sensor to detect accelerometer from x y z axis.
	  If the platform is supported for acceleometer, this
	  configuration should be configured, and the acceleometer
	  driver configuration should be configured as well.

source "drivers/misc/mediatek/sensors-1.0/accelerometer/accelhub/Kconfig"
#source "drivers/misc/mediatek/sensors-1.0/accelerometer/bmi160-spi/Kconfig"
#source "drivers/misc/mediatek/sensors-1.0/accelerometer/bmi160-i2c/Kconfig"
#source "drivers/misc/mediatek/sensors-1.0/accelerometer/bma2xx/Kconfig"
source "drivers/misc/mediatek/sensors-1.0/accelerometer/mc3433/Kconfig"
source "drivers/misc/mediatek/sensors-1.0/accelerometer/lsm6ds3hg/Kconfig"
source "drivers/misc/mediatek/sensors-1.0/accelerometer/lis3dh/Kconfig"
source "drivers/misc/mediatek/sensors-1.0/accelerometer/mc3410-i2c/Kconfig"
source "drivers/misc/mediatek/sensors-1.0/accelerometer/mpu6050g/Kconfig"
#Begin added by lanying.he for XR5424729 on 2017/10/20 
#source "drivers/misc/mediatek/sensors-1.0/accelerometer/A3A_mc3413-p/Kconfig"
source "drivers/misc/mediatek/sensors-1.0/accelerometer/significant_motion/Kconfig"
#End added by lanying.he for XR5424729 on 2017/10/20 
#Begin added by lanying.he for XR5592217 on 2017/11/22  
#source "drivers/misc/mediatek/sensors-1.0/accelerometer/A3A_bma253/Kconfig"
#End added by lanying.he for XR5592217 on 2017/11/22  
#Begin added by zhi.chen.hz for u5a bma253 on 2017/12/16  
source "drivers/misc/mediatek/sensors-1.0/accelerometer/U5A_bma253/Kconfig"
source "drivers/misc/mediatek/sensors-1.0/accelerometer/U5A_kxtj2/Kconfig"
#End added by zhi.chen.hz for u5a bma253 on 2017/12/16  
```

## kernel-4.4/drivers/misc/mediatek/sensors-1.0/accelerometer/U5A_bma253/Kconfig
```kconfig
config MTK_U5A_BMA2X2
	bool "BMA2X2 for MediaTek package"
	default y
config MTK_BMA2XX
	bool "bma2xx g-sensor for MediaTek package"
        default n
	help
	  bma2xx driver support some bosh g-sensor chip
	  such as bma220, bma222, etc .
	  now this driver is used for bma223.
```

## kernel-4.4/drivers/misc/mediatek/sensors-1.0/accelerometer/U5A_kxtj2/Kconfig
```kconfig
config MTK_U5A_KXTJ2
	bool "KXTJ2 for MediaTek package"
	default y
config MTK_KXTJ2
	bool "kxtj2 g-sensor for MediaTek package"
        default n
	help
	  kxtj2 driver support some bosh g-sensor chip.
	  now this driver is used for kxtj2.
```

## kernel-4.4/drivers/misc/mediatek/sensors-1.0/accelerometer/significant_motion/Kconfig
```kconfig
config MTK_SIGNIFICANT_SENSOR
	bool "MTK_SIGNIFICANT_SENSOR for MediaTek package"
	default n
	
```

## kernel-4.4/drivers/misc/mediatek/sensors-1.0/alsps/A3A_stk3x1x-s34/Kconfig
```kconfig
config MTK_A3A_STK3X1X_S34
    bool "stk3x1x for MediaTek package"
    default n
    help
    It support different type sensor
    in this platform. If this option
    is set, it will support ambient
    and light sensor STK3X1X.
```

## kernel-4.4/drivers/misc/mediatek/sensors-1.0/alsps/Kconfig
```kconfig
config CUSTOM_KERNEL_ALSPS
	bool "CUSTOM KERNEL ALSPS Config"
	help
	  ALSPS sensor driver to detect ambient light and the object is close
	  or far awary from device. After configure this configuration,
	  the specific ambient light and proximity sensor driver configuration
	  should be configured as well.

config MTK_AUTO_DETECT_ALSPS
	bool "MTK AUTO DETECT ALSPS Sensor"
	help
	  This feature Option is used for projects which using more than one
	  ALSPS sensors, more than one ALSPS drivers can be builded in to
	  project and be auto detected by setting this option to yes,
	  usually only one ALSPS driver can be probed.

source "drivers/misc/mediatek/sensors-1.0/alsps/alspshub/Kconfig"
source "drivers/misc/mediatek/sensors-1.0/alsps/cm36558/Kconfig"
source "drivers/misc/mediatek/sensors-1.0/alsps/cm36652/Kconfig"
source "drivers/misc/mediatek/sensors-1.0/alsps/cm36652-new/Kconfig"

#Begin added by lanying.he for XR5424729 on 2017/10/20 psensor driver
source "drivers/misc/mediatek/sensors-1.0/alsps/A3A_stk3x1x-s34/Kconfig"
#End added by lanying.he for XR5424729 on 2017/10/20 psensor driver

#Begin added by zhi.chen for ltr578 on 2017/10/20 psensor driver
source "drivers/misc/mediatek/sensors-1.0/alsps/U5A_ltr578/Kconfig"
source "drivers/misc/mediatek/sensors-1.0/alsps/U5A_stk3x1x/Kconfig"
#End added by zhi.chen for ltr578 on 2017/10/20 psensor driver
```

## kernel-4.4/drivers/misc/mediatek/sensors-1.0/alsps/U5A_stk3x1x/Kconfig
```kconfig
config MTK_U5A_STK3X1X
    bool "stk3x1x for MediaTek package"
    default n
    help
    It support different type sensor
    in this platform. If this option
    is set, it will support ambient
    and light sensor STK3X1X.
```

## kernel-4.4/drivers/misc/mediatek/u5a_pn553/Kconfig
```kconfig
config NFC_U5A_PN553
	bool "NXP NFC driver"
	default y
	help
	  Say Y here for supporting  NXP NFC PN547 PN548 PN553.
```

## kernel-4.4/kernel/printk/Kconfig
```kconfig
# Begin add smart log by yinghe for XR5424644 on 2017-11-14
config JRD_PRINTD
	bool "JRD_PRINTD"
	default n
	---help---
	  Select if you want to enable smart log.
# End add smart log by yinghe for XR5424644 on 2017-11-14
# Begin added by yinghe for XR5424657 on 2017/12/26
config TCT_BIGLOG
    bool "TCT_BIGLOG"
    default n
    ---help---
      Select if you want to enable smart info.
# End added by yinghe for XR5424657 on 2017/12/26
```
